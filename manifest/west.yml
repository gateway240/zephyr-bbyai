## manifest/west.yml
```yaml
manifest:
  self:
    west-commands: scripts/west-commands.yml

  remotes:
    - name: zephyrproject-rtos
      url-base: https://github.com/zephyrproject-rtos
    - name: beagley-ai-zephyr
      url-base: https://openbeagle.org/beagley-ai/zephyr
  
  projects:
    - name: zephyr
      remote: beagley-ai-zephyr
      revision: beagley-ai-dev
      import:
        name-allowlist:
          - hal_ti
          - cmsis
          - open-amp
          - libmetal
```
